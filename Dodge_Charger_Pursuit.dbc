VERSION ""

NS_ :

BS_:

BU_: XXX

BO_ 280 NEW_MSG_1: 8 XXX
 SG_ NEW_SIGNAL_1 : 7|24@0+ (1,0) [0|16777215] "" XXX

BO_ 258 NEW_MSG_2: 8 XXX
 SG_ NEW_SIGNAL_1 : 15|8@0+ (1,0) [0|255] "" XXX
