VERSION ""

NS_ :

BS_:

BU_: XXX

BO_ 258 NEW_MSG_1: 8 XXX
 SG_ Steering_Position : 7|24@0+ (1,0) [0|255] "" XXX

BO_ 264 Powertrain_Data: 8 XXX
 SG_ RPM : 7|16@0+ (1,0) [0|255] "" XXX
 SG_ TPS : 39|16@0+ (1,0) [0|65535] "" XXX
